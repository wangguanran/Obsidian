#include "parrot-audio-overlay.dtsi"

&waipio_snd {
	qcom,model = "parrot-qrd-snd-card";
	qcom,sku-model = "parrot-qrd-sku1-snd-card";
	nvmem-cells = <&adsp_variant>;
	nvmem-cell-names = "adsp_variant";
	qcom,msm-mbhc-usbc-audio-supported = <1>;
	qcom,msm-mbhc-hphl-swh = <0>;
	qcom,msm-mbhc-gnd-swh = <0>;
	qcom,audio-routing =
			"TX DMIC0", "Digital Mic0",
			"TX DMIC0", "VCC MIC BIAS1",
			"TX DMIC1", "Digital Mic1",
			"TX DMIC1", "VCC MIC BIAS1",
			"TX DMIC2", "Digital Mic2",
			"TX DMIC2", "VCC MIC BIAS1",
			"TX DMIC3", "Digital Mic3",
			"TX DMIC3", "VCC MIC BIAS1",
			"TX DMIC4", "Digital Mic4",
			"TX DMIC4", "VCC MIC BIAS1",
			"TX DMIC5", "Digital Mic5",
			"TX DMIC5", "VCC MIC BIAS1",
			"RX_TX DEC0_INP", "TX DEC0 MUX",
			"RX_TX DEC1_INP", "TX DEC1 MUX",
			"RX_TX DEC2_INP", "TX DEC2 MUX",
			"RX_TX DEC3_INP", "TX DEC3 MUX",
			"VA SWR_INPUT", "VA_SWR_CLK",
			"VA_AIF1 CAP", "VA_SWR_CLK",
			"VA_AIF2 CAP", "VA_SWR_CLK",
			"VA_AIF3 CAP", "VA_SWR_CLK";
};
