/dts-v1/;
/plugin/;

#include "bengal-nfc-mt5611.dtsi"
/ {
	model = "Qualcomm Technologies, Inc. BENGAL IDP";
	compatible = "qcom,bengal-idp", "qcom,bengal";
	qcom,msm-id = <417 0x10000>, <444 0x10000>;
	qcom,board-id = <49 0>;
};
