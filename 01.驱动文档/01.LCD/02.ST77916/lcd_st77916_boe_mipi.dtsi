/ { lcds {
	lcd_st77916_boe_mipi: lcd77916@77916 {
		panel-name = "lcd_st77916_boe_mipi";

		work-mode = <0>;
		bpp = <18>;
		lane-number = <1>;
		te-active = <0>;

		need-check-esd = <3>;
		esd-timeout = <1000>;
		esd-check-reg = <0x0A>;
		esd-return-code = <0x9C>;

		fps = <50>;
		width-mm = <35>;
		height-mm = <38>;

		power-on-sequence = <
			50  1  0
			50  0  0
			50  1  120
			>;
		power-off-sequence = <
			50  0  20
			>;

		init-data = [
            39 00 00 03 f0 00 28
            39 00 00 03 f2 00 28
            39 00 00 03 73 00 f0
            39 00 00 03 7c 00 d1
            39 00 00 03 83 00 00
            39 00 00 03 84 00 61
            39 00 00 03 f2 00 82
            39 00 00 03 f0 00 00
            39 00 00 03 f0 00 01
            39 00 00 03 f1 00 01
            39 00 00 03 b0 00 5a
            39 00 00 03 b1 00 39
            39 00 00 03 b2 00 30
            39 00 00 03 b3 00 01
            39 00 00 03 b4 00 26
            39 00 00 03 b5 00 34
            39 00 00 03 b6 00 8b
            39 00 00 03 b7 00 20
            39 00 00 03 b8 00 85
            39 00 00 03 b9 00 27
            39 00 00 03 ba 00 00
            39 00 00 03 bb 00 08
            39 00 00 03 bc 00 08
            39 00 00 03 bd 00 00
            39 00 00 03 be 00 00
            39 00 00 03 bf 00 07
            39 00 00 03 c0 00 80
            39 00 00 03 c1 00 10
            39 00 00 03 c2 00 64
            39 00 00 03 c3 00 80
            39 00 00 03 c4 00 10
            39 00 00 03 c5 00 48
            39 00 00 03 c6 00 03
            39 00 00 03 c7 00 13
            39 00 00 03 c8 00 F3
            39 00 00 03 c9 00 a9
            39 00 00 03 ca 00 41
            39 00 00 03 cb 00 01
            39 00 00 03 cc 00 7f
            39 00 00 03 cd 00 1f
            39 00 00 03 ce 00 ff
            39 00 00 03 d0 00 91
            39 00 00 03 d1 00 68
            39 00 00 03 d2 00 86
            39 00 00 04 f5 00 00 a5
            39 00 00 03 f1 00 10
            39 00 00 03 f0 00 00
            39 00 00 03 f0 00 02
            39 00 00 1d e0 00 f0 00 06 00 0b 00 09 00 09 00 16 00 2e 00 43 00 44 00 07 00 13 00 12 00 2a 00 30
            39 00 00 1d e1 00 f0 00 06 00 0b 00 09 00 08 00 15 00 2e 00 33 00 44 00 06 00 11 00 12 00 29 00 2f
            39 00 00 03 f0 00 10
            39 00 00 03 f3 00 10
            39 00 00 03 e0 00 0c
            39 00 00 03 e1 00 00
            39 00 00 03 e2 00 00
            39 00 00 03 e3 00 00
            39 00 00 03 e4 00 e0
            39 00 00 03 e5 00 06
            39 00 00 03 e6 00 21
            39 00 00 03 e7 00 10
            39 00 00 03 e8 00 45
            39 00 00 03 e9 00 82
            39 00 00 03 ea 00 e4
            39 00 00 03 eb 00 00
            39 00 00 03 ec 00 80
            39 00 00 03 ed 00 14
            39 00 00 03 ee 00 ff
            39 00 00 03 ef 00 00
            39 00 00 03 f8 00 ff
            39 00 00 03 f9 00 00
            39 00 00 03 fa 00 00
            39 00 00 03 fb 00 30
            39 00 00 03 fc 00 00
            39 00 00 03 fd 00 00
            39 00 00 03 fe 00 00
            39 00 00 03 ff 00 00
            39 00 00 03 60 00 40
            39 00 00 03 61 00 02
            39 00 00 03 62 00 00
            39 00 00 03 63 00 40
            39 00 00 03 64 00 04
            39 00 00 03 65 00 00
            39 00 00 03 66 00 00
            39 00 00 03 67 00 00
            39 00 00 03 68 00 00
            39 00 00 03 69 00 00
            39 00 00 03 6a 00 00
            39 00 00 03 6b 00 00
            39 00 00 03 70 00 40
            39 00 00 03 71 00 03
            39 00 00 03 72 00 00
            39 00 00 03 73 00 40
            39 00 00 03 74 00 05
            39 00 00 03 75 00 00
            39 00 00 03 76 00 00
            39 00 00 03 77 00 00
            39 00 00 03 78 00 00
            39 00 00 03 79 00 00
            39 00 00 03 7a 00 00
            39 00 00 03 7b 00 00
            39 00 00 03 80 00 48
            39 00 00 03 81 00 00
            39 00 00 03 82 00 06
            39 00 00 03 83 00 03
            39 00 00 03 84 00 22
            39 00 00 03 85 00 00
            39 00 00 03 86 00 00
            39 00 00 03 87 00 00
            39 00 00 03 88 00 48
            39 00 00 03 89 00 00
            39 00 00 03 8a 00 08
            39 00 00 03 8b 00 03
            39 00 00 03 8c 00 24
            39 00 00 03 8d 00 00
            39 00 00 03 8e 00 00
            39 00 00 03 8f 00 00
            39 00 00 03 90 00 48
            39 00 00 03 91 00 00
            39 00 00 03 92 00 0a
            39 00 00 03 93 00 03
            39 00 00 03 94 00 1e
            39 00 00 03 95 00 00
            39 00 00 03 96 00 00
            39 00 00 03 97 00 00
            39 00 00 03 98 00 48
            39 00 00 03 99 00 00
            39 00 00 03 9a 00 0c
            39 00 00 03 9b 00 03
            39 00 00 03 9c 00 20
            39 00 00 03 9d 00 00
            39 00 00 03 9e 00 00
            39 00 00 03 9f 00 00
            39 00 00 03 a0 00 48
            39 00 00 03 a1 00 00
            39 00 00 03 a2 00 07
            39 00 00 03 a3 00 03
            39 00 00 03 a4 00 23
            39 00 00 03 a5 00 00
            39 00 00 03 a6 00 00
            39 00 00 03 a7 00 00
            39 00 00 03 a8 00 48
            39 00 00 03 a9 00 00
            39 00 00 03 aa 00 09
            39 00 00 03 ab 00 03
            39 00 00 03 ac 00 25
            39 00 00 03 ad 00 00
            39 00 00 03 ae 00 00
            39 00 00 03 af 00 00
            39 00 00 03 b0 00 48
            39 00 00 03 b1 00 00
            39 00 00 03 b2 00 0b
            39 00 00 03 b3 00 03
            39 00 00 03 b4 00 1f
            39 00 00 03 b5 00 00
            39 00 00 03 b6 00 00
            39 00 00 03 b7 00 00
            39 00 00 03 b8 00 48
            39 00 00 03 b9 00 00
            39 00 00 03 ba 00 0d
            39 00 00 03 bb 00 03
            39 00 00 03 bc 00 21
            39 00 00 03 bd 00 00
            39 00 00 03 be 00 00
            39 00 00 03 bf 00 00
            39 00 00 03 c0 00 01
            39 00 00 03 c1 00 10
            39 00 00 03 c2 00 ff
            39 00 00 03 c3 00 57
            39 00 00 03 c4 00 ff
            39 00 00 03 c5 00 46
            39 00 00 03 c6 00 ff
            39 00 00 03 c7 00 75
            39 00 00 03 c8 00 ff
            39 00 00 03 c9 00 64
            39 00 00 03 d0 00 01
            39 00 00 03 d1 00 10
            39 00 00 03 d2 00 ff
            39 00 00 03 d3 00 57
            39 00 00 03 d4 00 ff
            39 00 00 03 d5 00 46
            39 00 00 03 d6 00 ff
            39 00 00 03 d7 00 75
            39 00 00 03 d8 00 ff
            39 00 00 03 d9 00 64
            39 00 00 03 f3 00 01
            39 00 00 03 f0 00 00
            39 00 00 03 36 00 00
            39 00 00 03 3a 00 66
            39 00 00 03 35 00 00
            39 00 00 09 2a 00 00 00 00 00 01 00 67
            39 00 00 09 2b 00 00 00 00 00 01 00 85
            13 00 00 01 21
            13 78 00 01 11
            13 00 00 01 29
			];
            // 13 78 00 01 1C // TEST MODE

		sleep-in = [
			13 78 00 01 28
			13 00 00 01 10
			39 00 00 03 f0 00 01
			39 00 00 03 f1 00 01
			39 78 00 03 cf 00 02
			];
		sleep-out = [
			13 78 00 01 11
			13 00 00 01 29
			];

		display-timings {
			clock-frequency = <260000>; // mipi clock frequency
			hactive = <360>;
			vactive = <390>;
			hback-porch = <80>;
			hfront-porch = <100>;
			hsync-len = <13>;
			vback-porch = <64>;
			vfront-porch = <64>;
			vsync-len = <27>;
		};
	};
};};

