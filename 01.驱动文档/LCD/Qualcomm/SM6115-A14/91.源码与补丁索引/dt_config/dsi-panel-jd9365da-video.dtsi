&mdss_mdp {
	dsi_jd9365da_video: qcom,mdss_dsi_jd9365da_video {
		qcom,mdss-dsi-panel-name = "jd9365da 720x1280 video mode dsi panel";
		qcom,mdss-dsi-panel-type = "dsi_video_mode";
		qcom,dsi-ctrl-num = <0>;
		qcom,dsi-phy-num = <0>;
		qcom,mdss-dsi-virtual-channel-id = <0>;
		qcom,mdss-dsi-stream = <0>;
		qcom,mdss-dsi-h-left-border = <0>;
		qcom,mdss-dsi-h-right-border = <0>;
		qcom,mdss-dsi-v-top-border = <0>;
		qcom,mdss-dsi-v-bottom-border = <0>;
		qcom,mdss-dsi-bpp = <24>;
		/* Factory PLL_CLOCK=205 (byte MHz) → ~411 MHz/lane bitclk:
		 * 870*1312*60*24/4 = 410746000 Hz */
		qcom,mdss-dsi-panel-clockrate = <411000000>;
		qcom,mdss-dsi-color-order = "rgb_swap_rgb";
		qcom,mdss-dsi-underflow-color = <0xff>;
		qcom,mdss-dsi-border-color = <0>;
		qcom,mdss-dsi-h-sync-pulse = <0>;
		/* UEFI DSITrafficMode=1 -> non_burst_sync_event */
		qcom,mdss-dsi-traffic-mode = "non_burst_sync_event";
		qcom,mdss-dsi-bllp-eof-power-mode;
		qcom,mdss-dsi-bllp-power-mode;
		/* UEFI DSILanes=4 */
		qcom,mdss-dsi-lane-0-state;
		qcom,mdss-dsi-lane-1-state;
		qcom,mdss-dsi-lane-2-state;
		qcom,mdss-dsi-lane-3-state;
		qcom,mdss-dsi-lane-map = "lane_map_0123";
		qcom,mdss-dsi-tx-eot-append;
		qcom,dsi-select-clocks = "pll_byte_clk0", "pll_dsi_clk0";
		qcom,mdss-dsi-dma-trigger = "trigger_sw";
		qcom,mdss-dsi-mdp-trigger = "none";
		qcom,mdss-dsi-lp11-init;
		qcom,mdss-dsi-te-pin-select = <1>;
		qcom,mdss-dsi-reset-sequence = <1 5>, <0 10>, <1 120>;
		qcom,mdss-pan-physical-width-dimension = <62>;
		qcom,mdss-pan-physical-height-dimension = <110>;
		/* Timing from UEFI Panel_jd9365da_720p_vid.xml Active Timing */
		qcom,mdss-dsi-display-timings {
			timing@0 {
				qcom,mdss-dsi-panel-width = <720>;
				qcom,mdss-dsi-panel-height = <1280>;
				qcom,mdss-dsi-h-front-porch = <50>;
				qcom,mdss-dsi-h-back-porch = <50>;
				qcom,mdss-dsi-h-pulse-width = <50>;
				qcom,mdss-dsi-h-sync-skew = <0>;
				qcom,mdss-dsi-v-back-porch = <12>;
				qcom,mdss-dsi-v-front-porch = <16>;
				qcom,mdss-dsi-v-pulse-width = <4>;
				qcom,mdss-dsi-panel-framerate = <60>;
				qcom,display-topology = <1 0 1>;
				qcom,default-topology-index = <0>;
				qcom,mdss-dsi-on-command = [
			29 01 00 00 00 00 02 E0 00
			29 01 00 00 00 00 02 E1 93
			29 01 00 00 00 00 02 E2 65
			29 01 00 00 00 00 02 E3 F8
			29 01 00 00 00 00 02 80 03
			29 01 00 00 00 00 02 E0 01
			29 01 00 00 00 00 02 00 00
			29 01 00 00 00 00 02 01 91
			29 01 00 00 00 00 02 03 10
			29 01 00 00 00 00 02 04 97
			29 01 00 00 00 00 02 17 00
			29 01 00 00 00 00 02 18 BF
			29 01 00 00 00 00 02 19 01
			29 01 00 00 00 00 02 1A 00
			29 01 00 00 00 00 02 1B BF
			29 01 00 00 00 00 02 1C 01
			29 01 00 00 00 00 02 24 FE
			29 01 00 00 00 00 02 37 09
			29 01 00 00 00 00 02 38 04
			29 01 00 00 00 00 02 39 08
			29 01 00 00 00 00 02 3A 1F
			29 01 00 00 00 00 02 3C 78
			29 01 00 00 00 00 02 3D FF
			29 01 00 00 00 00 02 3E FF
			29 01 00 00 00 00 02 3F FF
			29 01 00 00 00 00 02 40 04
			29 01 00 00 00 00 02 41 A0
			29 01 00 00 00 00 02 43 10
			29 01 00 00 00 00 02 44 0F
			29 01 00 00 00 00 02 45 24
			29 01 00 00 00 00 02 55 02
			29 01 00 00 00 00 02 57 85
			29 01 00 00 00 00 02 59 0A
			29 01 00 00 00 00 02 5A 38
			29 01 00 00 00 00 02 5B 10
			29 01 00 00 00 00 02 5D 7F
			29 01 00 00 00 00 02 5E 68
			29 01 00 00 00 00 02 5F 57
			29 01 00 00 00 00 02 60 4B
			29 01 00 00 00 00 02 61 46
			29 01 00 00 00 00 02 62 39
			29 01 00 00 00 00 02 63 3B
			29 01 00 00 00 00 02 64 25
			29 01 00 00 00 00 02 65 3D
			29 01 00 00 00 00 02 66 3B
			29 01 00 00 00 00 02 67 3A
			29 01 00 00 00 00 02 68 57
			29 01 00 00 00 00 02 69 44
			29 01 00 00 00 00 02 6A 4A
			29 01 00 00 00 00 02 6B 3C
			29 01 00 00 00 00 02 6C 37
			29 01 00 00 00 00 02 6D 29
			29 01 00 00 00 00 02 6E 16
			29 01 00 00 00 00 02 6F 00
			29 01 00 00 00 00 02 70 7F
			29 01 00 00 00 00 02 71 68
			29 01 00 00 00 00 02 72 57
			29 01 00 00 00 00 02 73 4B
			29 01 00 00 00 00 02 74 46
			29 01 00 00 00 00 02 75 39
			29 01 00 00 00 00 02 76 3B
			29 01 00 00 00 00 02 77 25
			29 01 00 00 00 00 02 78 3D
			29 01 00 00 00 00 02 79 3B
			29 01 00 00 00 00 02 7A 3A
			29 01 00 00 00 00 02 7B 57
			29 01 00 00 00 00 02 7C 44
			29 01 00 00 00 00 02 7D 4A
			29 01 00 00 00 00 02 7E 3C
			29 01 00 00 00 00 02 7F 37
			29 01 00 00 00 00 02 80 29
			29 01 00 00 00 00 02 81 16
			29 01 00 00 00 00 02 82 00
			29 01 00 00 00 00 02 E0 02
			29 01 00 00 00 00 02 00 57
			29 01 00 00 00 00 02 01 77
			29 01 00 00 00 00 02 02 44
			29 01 00 00 00 00 02 03 46
			29 01 00 00 00 00 02 04 48
			29 01 00 00 00 00 02 05 4A
			29 01 00 00 00 00 02 06 4C
			29 01 00 00 00 00 02 07 4E
			29 01 00 00 00 00 02 08 50
			29 01 00 00 00 00 02 09 5F
			29 01 00 00 00 00 02 0A 52
			29 01 00 00 00 00 02 0B 5F
			29 01 00 00 00 00 02 0C 5F
			29 01 00 00 00 00 02 0D 5F
			29 01 00 00 00 00 02 0E 5F
			29 01 00 00 00 00 02 0F 5F
			29 01 00 00 00 00 02 10 5F
			29 01 00 00 00 00 02 11 5F
			29 01 00 00 00 00 02 12 5F
			29 01 00 00 00 00 02 13 40
			29 01 00 00 00 00 02 14 5F
			29 01 00 00 00 00 02 15 5F
			29 01 00 00 00 00 02 16 57
			29 01 00 00 00 00 02 17 77
			29 01 00 00 00 00 02 18 45
			29 01 00 00 00 00 02 19 47
			29 01 00 00 00 00 02 1A 49
			29 01 00 00 00 00 02 1B 4B
			29 01 00 00 00 00 02 1C 4D
			29 01 00 00 00 00 02 1D 4F
			29 01 00 00 00 00 02 1E 51
			29 01 00 00 00 00 02 1F 5F
			29 01 00 00 00 00 02 20 53
			29 01 00 00 00 00 02 21 5F
			29 01 00 00 00 00 02 22 5F
			29 01 00 00 00 00 02 23 5F
			29 01 00 00 00 00 02 24 5F
			29 01 00 00 00 00 02 25 5F
			29 01 00 00 00 00 02 26 5F
			29 01 00 00 00 00 02 27 5F
			29 01 00 00 00 00 02 28 5F
			29 01 00 00 00 00 02 29 41
			29 01 00 00 00 00 02 2A 5F
			29 01 00 00 00 00 02 2B 5F
			29 01 00 00 00 00 02 2C 57
			29 01 00 00 00 00 02 2D 77
			29 01 00 00 00 00 02 2E 4F
			29 01 00 00 00 00 02 2F 4D
			29 01 00 00 00 00 02 30 4B
			29 01 00 00 00 00 02 31 49
			29 01 00 00 00 00 02 32 47
			29 01 00 00 00 00 02 33 45
			29 01 00 00 00 00 02 34 41
			29 01 00 00 00 00 02 35 5F
			29 01 00 00 00 00 02 36 53
			29 01 00 00 00 00 02 37 5F
			29 01 00 00 00 00 02 38 5F
			29 01 00 00 00 00 02 39 5F
			29 01 00 00 00 00 02 3A 5F
			29 01 00 00 00 00 02 3B 5F
			29 01 00 00 00 00 02 3C 5F
			29 01 00 00 00 00 02 3D 5F
			29 01 00 00 00 00 02 3E 5F
			29 01 00 00 00 00 02 3F 51
			29 01 00 00 00 00 02 40 5F
			29 01 00 00 00 00 02 41 5F
			29 01 00 00 00 00 02 42 57
			29 01 00 00 00 00 02 43 77
			29 01 00 00 00 00 02 44 4E
			29 01 00 00 00 00 02 45 4C
			29 01 00 00 00 00 02 46 4A
			29 01 00 00 00 00 02 47 48
			29 01 00 00 00 00 02 48 46
			29 01 00 00 00 00 02 49 44
			29 01 00 00 00 00 02 4A 40
			29 01 00 00 00 00 02 4B 5F
			29 01 00 00 00 00 02 4C 52
			29 01 00 00 00 00 02 4D 5F
			29 01 00 00 00 00 02 4E 5F
			29 01 00 00 00 00 02 4F 5F
			29 01 00 00 00 00 02 50 5F
			29 01 00 00 00 00 02 51 5F
			29 01 00 00 00 00 02 52 5F
			29 01 00 00 00 00 02 53 5F
			29 01 00 00 00 00 02 54 5F
			29 01 00 00 00 00 02 55 50
			29 01 00 00 00 00 02 56 5F
			29 01 00 00 00 00 02 57 5F
			29 01 00 00 00 00 02 58 40
			29 01 00 00 00 00 02 59 00
			29 01 00 00 00 00 02 5A 00
			29 01 00 00 00 00 02 5B 10
			29 01 00 00 00 00 02 5C 09
			29 01 00 00 00 00 02 5D 30
			29 01 00 00 00 00 02 5E 01
			29 01 00 00 00 00 02 5F 02
			29 01 00 00 00 00 02 60 30
			29 01 00 00 00 00 02 61 03
			29 01 00 00 00 00 02 62 04
			29 01 00 00 00 00 02 63 06
			29 01 00 00 00 00 02 64 6A
			29 01 00 00 00 00 02 65 75
			29 01 00 00 00 00 02 66 0F
			29 01 00 00 00 00 02 67 B3
			29 01 00 00 00 00 02 68 0B
			29 01 00 00 00 00 02 69 06
			29 01 00 00 00 00 02 6A 6A
			29 01 00 00 00 00 02 6B 10
			29 01 00 00 00 00 02 6C 00
			29 01 00 00 00 00 02 6D 04
			29 01 00 00 00 00 02 6E 04
			29 01 00 00 00 00 02 6F 88
			29 01 00 00 00 00 02 70 00
			29 01 00 00 00 00 02 71 00
			29 01 00 00 00 00 02 72 06
			29 01 00 00 00 00 02 73 7B
			29 01 00 00 00 00 02 74 00
			29 01 00 00 00 00 02 75 BC
			29 01 00 00 00 00 02 76 00
			29 01 00 00 00 00 02 77 05
			29 01 00 00 00 00 02 78 2E
			29 01 00 00 00 00 02 79 00
			29 01 00 00 00 00 02 7A 00
			29 01 00 00 00 00 02 7B 00
			29 01 00 00 00 00 02 7C 00
			29 01 00 00 00 00 02 7D 03
			29 01 00 00 00 00 02 7E 7B
			29 01 00 00 00 00 02 E0 04
			29 01 00 00 00 00 02 00 0E
			29 01 00 00 00 00 02 02 B3
			29 01 00 00 00 00 02 09 60
			29 01 00 00 00 00 02 0E 48
			29 01 00 00 00 00 02 E0 00
			05 01 00 00 78 00 02 11 00
			05 01 00 00 05 00 02 29 00
			05 01 00 00 00 00 02 35 00
				];
				/* cont_splash skips DSI_CMD_SET_ON in enable; bridge
				 * post_enable still runs POST_ON — re-send video on.
				 */
				qcom,mdss-dsi-post-panel-on-command = [
			05 01 00 00 78 00 02 11 00
			05 01 00 00 05 00 02 29 00
			05 01 00 00 00 00 02 35 00
				];
				qcom,mdss-dsi-off-command = [
			05 01 00 00 C8 00 02 28 00
			05 01 00 00 78 00 02 10 00
				];
				qcom,mdss-dsi-on-command-state = "dsi_lp_mode";
				qcom,mdss-dsi-post-on-command-state = "dsi_lp_mode";
				qcom,mdss-dsi-off-command-state = "dsi_lp_mode";
			};
		};
	};
};
